## board/saut/mx6sodimm/Kconfig
```kconfig
if TARGET_MX6SODIMM

	config SYS_BOARD
		default "mx6sodimm"
	
	config SYS_VENDOR
		default "saut"
	
	config SYS_CONFIG_NAME
		default "mx6sodimm"
	
	config SYS_TEXT_BASE
	    default 0x17800000

endif
```

## configs/mx6qsodimm_defconfig
```kconfig
CONFIG_ARM=y
CONFIG_ARCH_MX6=y
# CONFIG_LDO_BYPASS_CHECK is not set
CONFIG_TARGET_MX6SODIMM=y
CONFIG_ENV_SIZE=0x2000
CONFIG_ENV_OFFSET=0xE0000
CONFIG_DM_GPIO=y
CONFIG_NR_DRAM_BANKS=1
# CONFIG_LEGACY_IMAGE_FORMAT is not set
CONFIG_SYS_EXTRA_OPTIONS="IMX_CONFIG=board/saut/mx6sodimm/mx6sodimm.cfg"
CONFIG_BOOTDELAY=0
CONFIG_SYS_CONSOLE_OVERWRITE_ROUTINE=y
CONFIG_SUPPORT_RAW_INITRD=y
CONFIG_BOUNCE_BUFFER=y
# CONFIG_CMDLINE_EDITING is not set
# CONFIG_AUTO_COMPLETE is not set
# CONFIG_SYS_LONGHELP is not set
CONFIG_AUTOBOOT_KEYED=y
CONFIG_AUTOBOOT_PROMPT="Press 'G' to stop autoboot\n"
CONFIG_AUTOBOOT_STOP_STR="G"
# CONFIG_CMD_BDI is not set
# CONFIG_CMD_CONSOLE is not set
# CONFIG_CMD_BOOTD is not set
# CONFIG_CMD_BOOTM is not set
CONFIG_CMD_BOOTZ=y
# CONFIG_CMD_ELF is not set
# CONFIG_CMD_GO is not set
# CONFIG_CMD_RUN is not set
# CONFIG_CMD_IMI is not set
# CONFIG_CMD_XIMG is not set
# CONFIG_CMD_EXPORTENV is not set
# CONFIG_CMD_IMPORTENV is not set
# CONFIG_CMD_EDITENV is not set
# CONFIG_CMD_ENV_EXISTS is not set
# CONFIG_CMD_CRC32 is not set
# CONFIG_CMD_MEMORY is not set
# CONFIG_CMD_DM is not set
# CONFIG_CMD_FUSE is not set
# CONFIG_CMD_LOADB is not set
# CONFIG_CMD_LOADS is not set
CONFIG_CMD_MMC=y
CONFIG_CMD_READ=y
# CONFIG_CMD_ITEST is not set
# CONFIG_CMD_SOURCE is not set
# CONFIG_CMD_SETEXPR is not set
# CONFIG_CMD_BLOCK_CACHE is not set
# CONFIG_CMD_MISC is not set
CONFIG_CMD_EXT4=y
CONFIG_CMD_EXT4_WRITE=y
CONFIG_CMD_FS_GENERIC=y
CONFIG_DOS_PARTITION=y
CONFIG_OF_CONTROL=y
CONFIG_DEFAULT_DEVICE_TREE="imx6q-sodimm"
CONFIG_ENV_IS_IN_MMC=y
# CONFIG_NET is not set
# CONFIG_DM_WARN is not set
# CONFIG_DM_DEVICE_REMOVE is not set
CONFIG_REGMAP=y
CONFIG_SYSCON=y
CONFIG_DEVRES=y
CONFIG_GPIO_HOG=y
# CONFIG_MXC_GPIO is not set
CONFIG_DM_MMC=y
# CONFIG_MMC_VERBOSE is not set
CONFIG_FSL_USDHC=y
CONFIG_DM_REGULATOR=y
CONFIG_DM_REGULATOR_FIXED=y
CONFIG_IMX_THERMAL=y
# CONFIG_EFI_LOADER is not set
```
